#include "clear_orange.dtsi"

/* 既存のkscan0ノードへの追加設定 */
&kscan0 {
    col-gpios
        = <&gpio0 31 GPIO_ACTIVE_LOW>
        , <&gpio0 29 GPIO_ACTIVE_LOW>
        , <&gpio0 2  GPIO_ACTIVE_LOW>
        , <&gpio1 15 GPIO_ACTIVE_LOW>
        , <&gpio1 13 GPIO_ACTIVE_LOW>
        , <&gpio1 11 GPIO_ACTIVE_LOW>
        , <&gpio0 10 GPIO_ACTIVE_LOW>
        ;
};

/* 新しいノードの定義はここから */
/ {
    trackball_listener: trackball_listener {
        compatible = "zmk,input-listener";
        device = <&trackball>;
    };

    trackball: trackball {
        compatible = "pixart,pmw3610";
        status = "okay";

        /* 回路図: PIN 12 = P1.06 (SCLK), PIN 11 = P1.04 (SDIO) [cite: 4, 6, 48, 49, 53, 54] */
        sclk-gpios = <&gpio1 6 GPIO_ACTIVE_HIGH>;
        sdio-gpios = <&gpio1 4 GPIO_ACTIVE_HIGH>;

        /* 割り込みピン(MOTSWK)は回路図で未接続のため、未使用のP0.06を割り当て [cite: 6] */
        irq-gpios = <&gpio0 6 (GPIO_ACTIVE_LOW | GPIO_PULL_UP)>;

        cpi = <800>;
    };
};
