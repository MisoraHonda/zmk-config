/ {
    kscan0: kscan {
        compatible = "zmk,kscan-gpio-matrix";

        diode-direction = "row2col";

        row-gpios =
            <&gpio0 7 GPIO_ACTIVE_LOW>,
            <&gpio0 8 GPIO_ACTIVE_LOW>,
            <&gpio0 9 GPIO_ACTIVE_LOW>,
            <&gpio0 10 GPIO_ACTIVE_LOW>;

        col-gpios =
            <&gpio0 20 GPIO_ACTIVE_LOW>,
            <&gpio0 19 GPIO_ACTIVE_LOW>,
            <&gpio0 18 GPIO_ACTIVE_LOW>,
            <&gpio0 17 GPIO_ACTIVE_LOW>,
            <&gpio0 16 GPIO_ACTIVE_LOW>,
            <&gpio0 15 GPIO_ACTIVE_LOW>,
            <&gpio0 14 GPIO_ACTIVE_LOW>;
    };
};
