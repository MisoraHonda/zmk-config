kscan0: kscan {
        compatible = "zmk,kscan-gpio-matrix";
        // 1. もしこれでダメなら col2row に変えてみる
        diode-direction = "row2col"; 

        // 2. プルアップ(PULL_UP)に変更し、ACTIVE_LOW に設定
        row-gpios
            = <&gpio0 22 (GPIO_ACTIVE_LOW | GPIO_PULL_UP)>
            , <&gpio0 24 (GPIO_ACTIVE_LOW | GPIO_PULL_UP)>
            , <&gpio1 0  (GPIO_ACTIVE_LOW | GPIO_PULL_UP)>
            , <&gpio0 11 (GPIO_ACTIVE_LOW | GPIO_PULL_UP)>
            ;

        col-gpios
            = <&gpio0 31 GPIO_ACTIVE_LOW>
            , <&gpio0 29 GPIO_ACTIVE_LOW>
            , <&gpio0 2  GPIO_ACTIVE_LOW>
            , <&gpio1 15 GPIO_ACTIVE_LOW>
            , <&gpio1 13 GPIO_ACTIVE_LOW>
            , <&gpio1 11 GPIO_ACTIVE_LOW>
            , <&gpio0 10 GPIO_ACTIVE_LOW>
            ;
    };
