## boards/shields/clear_orange/Kconfig.shield
```kconfig
# No whitespace after the comma or in your part name!
config SHIELD_CLEAR_ORANGE_LEFT
    def_bool $(shields_list_contains,clear_orange_left)

# No whitespace after the comma or in your part name!
config SHIELD_CLEAR_ORANGE_RIGHT
    def_bool $(shields_list_contains,clear_orange_right)
```

## config/Kconfig
```kconfig
# config/Kconfig
osource "../../zmk-pmw3610-driver/Kconfig"
osource "../../zmk-input-behavior-listener/Kconfig"
```

## config/boards/shields/clear_orange/Kconfig.shield
```kconfig
config SHIELD_CLEAR_ORANGE_LEFT
    def_bool $(shields_list_contains,clear_orange_left)

config SHIELD_CLEAR_ORANGE_RIGHT
    def_bool $(shields_list_contains,clear_orange_right)
```

## config/dts/bindings/pixart,mx8650.yaml
```yaml
description: MX8650 optical mouse sensor

compatible: "pixart,mx8650"

include: [sensor-device.yaml]

properties:
  sclk-gpios:
    type: phandle-array
    required: true
  sdio-gpios:
    type: phandle-array
    required: true
```

## config/shields/clear_orange/Kconfig.defconfig
```kconfig
if SHIELD_CLEAR_ORANGE_LEFT

# Name must be less than 16 characters long!
config ZMK_KEYBOARD_NAME
    default "clear_orange"

config ZMK_SPLIT_ROLE_CENTRAL
    default y

endif

if SHIELD_CLEAR_ORANGE_LEFT || SHIELD_CLEAR_ORANGE_RIGHT

config ZMK_SPLIT
    default y

endif
```
