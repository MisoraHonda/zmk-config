#include "clear_orange.dtsi"

&kscan0 {
    col-gpios
        = <&gpio0 31 GPIO_ACTIVE_LOW>
        , <&gpio0 29 GPIO_ACTIVE_LOW>
        , <&gpio0 2  GPIO_ACTIVE_LOW>
        , <&gpio1 15 GPIO_ACTIVE_LOW>
        , <&gpio1 13 GPIO_ACTIVE_LOW>
        , <&gpio1 11 GPIO_ACTIVE_LOW>
        , <&gpio0 10 GPIO_ACTIVE_LOW>
        ;
};
