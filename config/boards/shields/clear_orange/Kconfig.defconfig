## config/boards/shields/clear_orange/Kconfig.defconfig
```kconfig
config ZMK_BOARD_COMPAT
    def_bool y

if SHIELD_CLEAR_ORANGE_RIGHT

config ZMK_SPLIT_BLE_ROLE_CENTRAL
    default y

endif
```

## config/west.yml
```yaml
manifest:
  remotes:
    - name: zmkfirmware
      url-base: https://github.com/zmkfirmware
    - name: sekigon-gonnoc
      url-base: https://github.com/sekigon-gonnoc
  projects:
    - name: zmk
      remote: zmkfirmware
      revision: main
      import: app/west.yml
    - name: zmk-component-bmp-boost
      remote: sekigon-gonnoc
      revision: master
    # ▼ 【重要】ログで怒られていた未定義エラーを消し去るための必須パーツを追加
    - name: zmk-feature-non-lipo-battery-management
      remote: sekigon-gonnoc
      revision: main
  self:
    path: config
```
